## zephyr/boards/evkmimx8mp/armgcc_aarch64/build_singlecore/Kconfig/Kconfig.modules
```kconfig
menu "hal_nxp (/home/efacec/nxp/Repositories/hww/modules/hal/nxp)"
osource "$(ZEPHYR_HAL_NXP_KCONFIG)"
config ZEPHYR_HAL_NXP_MODULE
	bool
	default y
endmenu
```
